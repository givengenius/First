/dts-v1/;
/plugin/;

/ {
    compatible = "allwinner,sun50i-h618";

    fragment@0 {
        target = <&emac0>;
        __overlay__ {

            phy-mode = "rgmii";
            phy-handle = <&rgmii_phy>;

            status = "okay";

            mdio {
                rgmii_phy: ethernet-phy@1 {
                    compatible = "ethernet-phy-ieee802.3-c22";
                    reg = <1>;
                };
            };
        };
    };
};
